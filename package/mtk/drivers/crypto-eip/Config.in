## package/mtk/drivers/crypto-eip/Config.in
```kconfig
menu "Crypto Offload Configuration"
	depends on PACKAGE_kmod-crypto-eip && PACKAGE_kmod-mediatek_hnat

choice
	prompt "Crypto Offload Mode"
	default CRYPTO_OFFLOAD_INLINE
	help
	  This port supports inline XFRM packet offload only.

config CRYPTO_OFFLOAD_INLINE
	bool "Inline Mode"
	depends on TARGET_mediatek_mt7988 || TARGET_mediatek_filogic_a73 || TARGET_DEVICE_mediatek_filogic_DEVICE_bananapi_bpi-r4 || TARGET_DEVICE_mediatek_filogic_DEVICE_bananapi_bpi-r4-poe || TARGET_DEVICE_mediatek_filogic_DEVICE_bananapi_bpi-r4-pro || TARGET_DEVICE_mediatek_filogic_DEVICE_mediatek_mt7988a-rfb || TARGET_DEVICE_mediatek_filogic_DEVICE_mediatek_mt7988d-rfb
	select PACKAGE_kmod-crypto-eip-inline
	select PACKAGE_kmod-crypto-eip-ddk
	select PACKAGE_kmod-crypto-eip-ddk-ksupport
	select PACKAGE_kmod-crypto-eip-ddk-ctrl
	select PACKAGE_kmod-crypto-eip-ddk-ctrl-app
	select PACKAGE_kmod-crypto-eip-ddk-engine
	select PACKAGE_crypto-eip-inline-fw
	select PACKAGE_strongswan
	select PACKAGE_strongswan-mod-kdf
	select PACKAGE_strongswan-default
endchoice

choice
	prompt "Crypto XFRM Offload Method"
	depends on CRYPTO_OFFLOAD_INLINE
	default CRYPTO_XFRM_OFFLOAD_MTK_PCE
	help
	  Use the MTK PCE classifier and CDRT tables for XFRM packet offload.

config CRYPTO_XFRM_OFFLOAD_MTK_PCE
	bool "Enable MTK PCE XFRM Offload"
endchoice

config CRYPTO_MTK_DDK_LOOKASIDE
	bool
	default n
	help
	  select y to enable ddk look-aside mode

config CRYPTO_OFFLOAD_INLINE_FLOWBLOCK
	bool
	depends on !PACKAGE_kmod-mediatek_hnat
	default n

endmenu
```

## package/mtk/drivers/mt_wifi_osal/Config.in
```kconfig
config MTK_WIFI_OSAL_DEBUG
	bool "verbose debugging"
	depends on PACKAGE_kmod-mt_wifi_osal
	default n
	help
	  Say Y, if you need mt_wifi_osal to display debug messages.

config MTK_WIFI_OSAL_CFG80211_SUPPORT
	bool "support cfg80211"
	depends on PACKAGE_kmod-mt_wifi_osal
	default n
	help
	  support cfg80211

config MTK_WIFI_OSAL_CUSTOM_VPRINTK
	bool "custom facility"
	depends on PACKAGE_kmod-mt_wifi_osal
	default n
	help
	  use custom vprintk for logging

config MTK_WIFI_OSAL_CUSTOM_VPRINTK_FACILITY
	int "custom facility"
	depends on MTK_WIFI_OSAL_CUSTOM_VPRINTK
	default 18
	help
	  use custom facility for logging

config MTK_WIFI_OSAL_NETIF_RX_DISPATCH
	bool "rx skb dispatch"
	depends on PACKAGE_kmod-mt_wifi_osal
	default n
	help
	  Say Y, if you need mt_wifi_osal to dispatch rx skb.


config MTK_WIFI_OSAL_FIPS_SUPPORT
	bool "OSAL FIPS Generic Netlink transport"
	depends on PACKAGE_kmod-mt_wifi_osal
	default n
	help
	  Enable only for drivers registering netdevices through the full OSAL
	  interface. The legacy WiFi7 WEXT compatibility driver does not implement
	  this transport; its netdevice private layout is different.
```

## package/mtk/drivers/mtk_npu/Config.in
```kconfig
menu "NPU Configurations"
	depends on PACKAGE_kmod-npu

choice
	prompt "NPU Offload Target"
	default MTK_NPU_REBB_SUPPORT
	help
	  Determine NPU offload support target

config MTK_NPU_REBB_SUPPORT
	bool "MTK NPU support ReBB"
	select PACKAGE_npu-rebb-fw

endchoice

source "$(SOURCE)/Config-protocols.in"
source "$(SOURCE)/Config-features.in"

# Enabled by the MT7988 firmware profile; hardware boot/delivery and byte
# reconciliation still require board validation. Keep an explicit opt-out.
config MTK_NPU_24_10_TUNNEL_BACKEND
	bool "Enable 24.10 TOPS/HNAT tunnel backend"
	depends on !MTK_NPU_24_10_DPDK_BACKEND
	depends on !MTK_NPU_24_10_FLOW_BACKEND
	default y
	help
	  Integrated HNAT backend for basic IPv4 GRETAP, VXLAN, L2TPv2 and PPTP.
	  Unsupported packets keep software forwarding. Requires matching kernel,
	  Ethernet, HNAT, PCE and PPP providers; do not mix old kernel modules.

config MTK_NPU_24_10_MCAST_BACKEND
	bool "Enable 24.10 TOPS/HNAT multicast backend"
	depends on !MTK_NPU_24_10_DPDK_BACKEND
	depends on !MTK_NPU_24_10_FLOW_BACKEND
	default y
	help
	  Replicate IPv4/IPv6 ASM bridge groups through the NPU using kernel
	  MDB membership. Unsupported clients, source filters and VLAN groups
	  retain software forwarding.

config MTK_NPU_24_10_FLOW_BACKEND
	bool "Use the native Linux flowtable NPU backend"
	depends on !MTK_NPU_24_10_DPDK_BACKEND
	default n
	help
	  Optional alternative to vendor HNAT, using the native PPE driver.
	  Supports plain IPv4 PPTP and L2TPv2 over the Ethernet GMAC2/GMAC3
	  underlay. Select kmod-npu-flow and disable vendor HNAT and drivers
	  which require it. HNAT remains the main router backend for GRETAP,
	  VXLAN, VLAN/PPPoE adaptation, multicast and vendor WiFi acceleration.

config MTK_NPU_24_10_OTHER_BACKENDS
	bool
	default n

config MTK_NPU_24_10_DPDK_BACKEND
	bool "Use the exclusive NPU DPDK MAC-filter backend"
	default n
	help
	  Select the vendor's customized DPDK MAC-filter mode instead of the
	  router tunnel/HNAT backend. This does not provide a full userspace
	  DPDK packet-processing stack. The two firmware modes cannot coexist.

config MTK_NPU_SECURE_FW
	bool "NPU Secure Firmware Load"
	default n
	help
	  Enable NPU secure firmware load

config MTK_NPU_MEM_TEST
	bool "NPU Memory Test"
	depends on !MTK_NPU_SECURE_FW
	default y
	help
	  Set y to execute the memory test during the NPU bring-up process.
	  The memory test will write some of specific patterns to NPU memory,
	  then read it back and compare it to ensure data correctness.
	  This is primarily used to verify the integrity of the memory and its
	  accessibility by the APMCU.

config MTK_NPU_THERMAL
	bool "NPU Thermal"
	default y
	help
	  Set y to enable thermal feature which will automatically throttle
	  NPU usage when the system detects that the board's temperature is
	  too high. The mechanism for throttling NPU usage rate is MCU's
	  dynamic frequency scaling.

config MTK_NPU_LOGGER
	bool "NPU Logger"
	depends on KERNEL_DEBUG_FS
	default n
	help
	  Set y to enable logger feature which logs the firmware log to relayfs.
	  Logger feature is runtime turned off by default. To save firmware log
	  for easier debug, logger feature should be further runtime turned on by a
	  user tool (npu-tool's logger) which is responsible to save the firmware log
	  from relayfs to flash.

config MTK_NPU_LOGGER_FW_DEFAULT_RUNNING
	bool "NPU Logger Firmware Default Running"
	depends on MTK_NPU_LOGGER
	default n
	help
	  Set y to turn on firmware logger feature by default. It's mainly used to
	  capture the firmware's cold boot log. If there's no need to capture it,
	  please set n.

config MTK_NPU_SUPPORT
	bool
	default y
	depends on PACKAGE_kmod-npu

config MTK_NPU
	bool
	depends on PACKAGE_kmod-npu

config MTK_NPU_HNAT
	bool
	depends on PACKAGE_kmod-npu-nf_hnat
	help
	  Set y to enable NPU tunnel offload feature with HNAT support. These
	  two hardware features cooperatively offload tunnel packets from Host
	  CPU and accelerate tunnel packets Tx/Rx throughput dramatically.

config MTK_NPU_FLOW
	bool
	depends on PACKAGE_kmod-npu-flow
	help
	  Set y to enable NPU tunnel offload feature with flowblock support. These
	  two hardware features cooperatively offload tunnel packets from Host
	  CPU and accelerate tunnel packets Tx/Rx throughput dramatically.

config MTK_NPU_MCAST
	bool
	depends on PACKAGE_kmod-npu-mcast && MTK_NPU_24_10_MCAST_BACKEND
	help
	  set y to enable NPU network offload feature with IPv4/IPv6 multicast
	  support.

config MTK_NPU_DPDK
	bool
	depends on PACKAGE_kmod-npu-dpdk
	help
	  set y to enable NPU network offload feature with DPDK customized
	  function. Note that, this feature does not compatible with other NPU
	  features.

choice
	prompt "MTK NPU DPDK MAC Filter entry num"
	depends on MTK_NPU_DPDK
	default MTK_NPU_DPDK_MAC_FILTER_NUM_1024
	help
	  set number of entries that NPU is able to support DPDK MAC filter
	  feature.

config MTK_NPU_DPDK_MAC_FILTER_NUM_1024
	bool "Reserve 1024 entries for mac filter table"

config MTK_NPU_DPDK_MAC_FILTER_NUM_128
	bool "Reserve 128 entries for mac filter table"

endchoice

config MTK_NPU_DPDK_MAC_FILTER_NUM
	int
	depends on MTK_NPU_DPDK
	default 1024 if MTK_NPU_DPDK_MAC_FILTER_NUM_1024
	default 128  if MTK_NPU_DPDK_MAC_FILTER_NUM_128

config MTK_NPU_STATISTIC
	bool "MTK NPU support statistic for various subsystems"
	depends on KERNEL_DEBUG_FS
	default y
	help
	  set y to enable NPU to collect its subsystem's status.
endmenu
```

## target/linux/mediatek/image/Config.in
```kconfig
menuconfig MTK_SECURE_BOOT
	bool "Enable MediaTek FIT signing"
	depends on TARGET_mediatek
	select PACKAGE_dmsetup
	select PACKAGE_cryptsetup
	default n
	help
	  Sign FIT images and verify them with a trusted U-Boot control DTB.
	  The target bootloader must implement the selected algorithms and
	  enforce the same required keys. This does not provision BL2/FIP keys,
	  enable BootROM authentication, burn eFuses, or enable anti-rollback.
	  Only payloads inside the FIT are covered. A separate rootfs needs its
	  own verification mechanism.

if MTK_SECURE_BOOT

config SBC_KEY_DIR
	string "FIT signing key directory"
	default "../../keys"
	help
	  Absolute path or path relative to the build root. Never commit keys.

config FIT_VERIFY_KEY_DTB
	string "Trusted U-Boot control DTB for FIT verification"
	help
	  Must contain the keys enforced by the installed target bootloader,
	  marked required = "conf". Hybrid requires required-mode = "all".
	  Missing keys or signatures cause the image build to fail.

choice
	prompt "FIT signing profile"
	default SBC_PROFILE_CLASSICAL

config SBC_PROFILE_CLASSICAL
	bool "Classical (RSA/ECC)"

config SBC_PROFILE_PQC
	bool "PQC (ML-DSA-87; requires a compatible target verifier)"

config SBC_PROFILE_HYBRID
	bool "Hybrid (Classical and ML-DSA-87; requires both target verifiers)"
endchoice

if SBC_PROFILE_CLASSICAL || SBC_PROFILE_HYBRID

config FIT_SIGN_KEY_NAME
	string "FIT classical key name"
	default "fit_key"

config FIT_SIGN_ALG
	string "FIT classical signing algorithm"
	default "sha256,rsa2048"
	help
	  For example sha256,rsa2048 or sha512,ecdsa521. Append ,offline
	  for external RSA signatures. Offline mode exports a digest under
	  KEY_DIR/fit-signatures and requires its verified .sig on the next
	  build, with the same SOURCE_DATE_EPOCH. It never uses a private key.
endif

if SBC_PROFILE_PQC || SBC_PROFILE_HYBRID

config FIT_PQC_SIGN_KEY_NAME
	string "FIT ML-DSA-87 key name"
	default "fit_pqc_key"

config FIT_PQC_SIGN_ALG
	string "FIT ML-DSA-87 signing algorithm"
	default "sha512,mldsa87"
endif

menuconfig MTK_FW_ENC
	bool "Enable firmware encryption"
	default n
	help
	  Select mtk firmware encryption

if MTK_FW_ENC

choice
	prompt "Choose rootfs encryption method"
	default MTK_FW_ENC_USE_RAMDISK

config MTK_FW_ENC_USE_RAMDISK
	bool "use RAM disk"
	select KERNEL_BLK_DEV_RAM
	help
	  decrypt the whold rootfs to RAM, and mounting as RAM disk

endchoice

choice
	prompt "Choose firmware decryption backend"
	default FW_ENC_DECRYPT_VIA_BL32

config FW_ENC_DECRYPT_VIA_BL31
	bool "Decrypt firmware via BL31"

config FW_ENC_DECRYPT_VIA_BL32
	bool "Decrypt firmware via BL32"
	select PACKAGE_optee-mediatek
	select OPTEE_FW_ENC_EARLY_TA

endchoice

config FW_ENC_ALG
	string
	default "tee_aes256" if FW_ENC_DECRYPT_VIA_BL31
	default "optee_aes256" if FW_ENC_DECRYPT_VIA_BL32

config PLAT_KEY_NAME
	string "platform key name"
	default "plat_key"

config ROE_SALT
	string "ROE key salt"
	default "salt/roe_salt.bin"

config KERNEL_SALT
	string "Kernel encryption key salt"
	default "salt/kernel_salt.bin"

config ROOTFS_SALT
	string "Rootfs encryption key salt"
	default "salt/rootfs_salt.bin"

endif # MTK_FW_ENC

menuconfig MTK_ANTI_ROLLBACK
	bool "Enable Anti-Rollback"
	default n
	help
	  Select mtk anti-rollback

if MTK_ANTI_ROLLBACK

config ANTI_ROLLBACK_TABLE
	string "Anti-Rollback table"
	default "../../fw_ar_table.xml"

config AUTO_AR_CONF
	string "Anti-Rollback auto config"
	default "auto_ar_conf.mk"

endif # MTK_ANTI_ROLLBACK

endif # MTK_SECURE_BOOT
```
